## components/agent/Kconfig
```kconfig
menu "ESP Agent Config"

    config ESP_AGENT_SERVER_URL
        string "ESP Private Agents Server URL"
        default "wss://api.agents.espressif.com"
        help
            This is the Websocket URL for ESP Private Agents Server.

endmenu
```

## components/audio/Kconfig
```kconfig
menu "Audio Config"

    config ENABLE_AEC
        bool "Enable AEC (Acoustic Echo Cancellation)"
        default n
        help
            Ensure the board supports AEC hardware acceleration.

endmenu
```

## components/setup/Kconfig.projbuild
```kconfig
menu "ESP Agent Setup Configuration"

    config AGENT_SETUP_RAINMAKER_DEVICE_NAME
        string "RainMaker Device Name"
        default "Espressif AI Agent"
        help
            This is the name of the device that will be visible in the RainMaker Phone app.

    config AGENT_SETUP_DEFAULT_AGENT_ID
        string "Default agent ID"
        default ""
        help
            Default Agent ID

    config AGENT_SETUP_CREATE_RAINMAKER_DEVICE
        bool "Create RainMaker device for Agent configuration"
        default y
        help
            When enabled, setup_rainmaker_init() will create a RainMaker device for configuring the agent
            This device can be used for configuing the agent ID and volume of device as RainMaker params.

            You may disable this option if you do not want the Agent ID to be configurable from the RainMaker app.
            Or if you are creating another RainMaker device for this purpose.

            Note: The user auth service is always created regardless of this option.

endmenu
```

## examples/common/app_common/Kconfig
```kconfig
menu "App Common Config"

    config APP_EMOTE_PARTITION_LABEL
        string "Emote Partition Label"
        default "anim_icon"
        help
            This is the partition label for the emote assets.

    config APP_EMOTE_TASK_CORE_ID
        int "Emote Task Core ID"
        default 0
        range 0 1
        help
            This is used to pin the gfx emote task to a specific core.

    config APP_AUDIO_DEFAULT_PLAYBACK_VOLUME
        int "Default Playback Volume"
        default 75
        range 0 100
        help
            This is the default volume for the playback device.

    config AUDIO_UPLOAD_SAMPLE_RATE
        int "Upload sample rate"
        default 8000
        help
            Upload sample rate in Hz.

    config AUDIO_DOWNLOAD_SAMPLE_RATE
        int "Download sample rate"
        default 16000
        help
            Download sample rate in Hz.

    config AUDIO_UPLOAD_FRAME_DURATION_MS
        int "Upload frame duration"
        default 20
        help
            Upload frame duration in milliseconds.

    config AUDIO_DOWNLOAD_FRAME_DURATION_MS
        int "Download frame duration"
        default 60
        help
            Download frame duration in milliseconds.

endmenu
```

## examples/common/boards/esp_box_3/sdkconfig.defaults
```kconfig
# SPIRAM quad mode
CONFIG_SPIRAM_MODE_OCT=y

# OCT PSRAM 120 MHz is not stable
CONFIG_SPIRAM_SPEED_80M=y
CONFIG_ESPTOOLPY_FLASHFREQ_80M=y
```

## examples/common/boards/m5stack_cores3/sdkconfig.defaults
```kconfig
# SPIRAM quad mode
CONFIG_SPIRAM_MODE_QUAD=y

# Quad PSRAM 120 MHz is stable
CONFIG_SPIRAM_SPEED_120M=y
CONFIG_ESPTOOLPY_FLASHFREQ_120M=y
```

## examples/common/boards/m5stack_cores3_h2_gateway/sdkconfig.defaults
```kconfig
# SPIRAM quad mode
CONFIG_SPIRAM_MODE_QUAD=y

# Quad PSRAM 120 MHz is stable
CONFIG_SPIRAM_SPEED_120M=y
CONFIG_ESPTOOLPY_FLASHFREQ_120M=y

# Thread Border Router

# Increase Thread task size
CONFIG_THREAD_TASK_STACK_SIZE=8192

# LWIP
CONFIG_LWIP_IPV6_FORWARD=y
CONFIG_LWIP_IPV6_AUTOCONFIG=y
CONFIG_LWIP_IPV6_NUM_ADDRESSES=12
CONFIG_LWIP_MULTICAST_PING=y
CONFIG_LWIP_NETIF_STATUS_CALLBACK=y
CONFIG_LWIP_HOOK_IP6_ROUTE_DEFAULT=y
CONFIG_LWIP_HOOK_ND6_GET_GW_DEFAULT=y
CONFIG_LWIP_HOOK_IP6_INPUT_CUSTOM=y
CONFIG_LWIP_HOOK_IP6_SELECT_SRC_ADDR_CUSTOM=y

# ESP Border Router will also enable a route hook so we don't need the route hook in matter
CONFIG_ENABLE_ROUTE_HOOK=n

# mbedTLS
CONFIG_MBEDTLS_KEY_EXCHANGE_ECJPAKE=y
CONFIG_MBEDTLS_SSL_PROTO_DTLS=y
CONFIG_MBEDTLS_ECJPAKE_C=y
CONFIG_MBEDTLS_HKDF_C=y

# OpenThread
CONFIG_OPENTHREAD_ENABLED=y
CONFIG_OPENTHREAD_LOG_LEVEL_DYNAMIC=n
CONFIG_OPENTHREAD_LOG_LEVEL_NOTE=y
CONFIG_OPENTHREAD_SRP_CLIENT=n
CONFIG_OPENTHREAD_DNS_CLIENT=n
CONFIG_OPENTHREAD_BORDER_ROUTER=y
CONFIG_THREAD_NETWORK_COMMISSIONING_DRIVER=n
CONFIG_OPENTHREAD_CLI=n
CONFIG_AUTO_UPDATE_RCP=n

# Matter
CONFIG_ENABLE_MATTER_OVER_THREAD=n
```

## examples/matter_controller/components/matter_controller/Kconfig
```kconfig
menu "ESP Client Only Matter Controller Config"

    config ESP_CLIENT_ONLY_MATTER_CONTROLLER
        bool "Enable client only matter controller"
        depends on ESP_MATTER_CONTROLLER_ENABLE
        depends on !ESP_MATTER_ENABLE_MATTER_SERVER
        depends on !ESP_MATTER_COMMISSIONER_ENABLE
        depends on !WIFI_NETWORK_COMMISSIONING_DRIVER
        depends on !THREAD_NETWORK_COMMISSIONING_DRIVER
        depends on !ENABLE_CHIPOBLE
        default n
        select ENABLE_CHIP_CONTROLLER_BUILD
        select RMAKER_REST_API_ENABLED
        help
            This enables the client only matter controller.

            IMPORTANT: The following configurations must be disabled for this option to be available:
            - Matter server (ESP_MATTER_ENABLE_MATTER_SERVER)
            - Matter commissioner (ESP_MATTER_COMMISSIONER_ENABLE)
            - WiFi network commissioning driver (WIFI_NETWORK_COMMISSIONING_DRIVER)
            - Thread network commissioning driver (THREAD_NETWORK_COMMISSIONING_DRIVER)
            - BLE (ENABLE_CHIPOBLE)

            If any of these conditions are not met, this option will not be visible in menuconfig.
            Please configure them first, then enable this option.
endmenu
```
